## sdkconfig.defaults
```kconfig
# CONFIG_LWIP_NETIF_DEBUG=y
# CONFIG_LWIP_SOCKETS_DEBUG=y
# CONFIG_LWIP_IP_DEBUG=y
CONFIG_ESPTOOLPY_FLASHSIZE_4MB=y
CONFIG_ESP_SYSTEM_PANIC_PRINT_HALT=y
CONFIG_LOG_DEFAULT_LEVEL_DEBUG=y
```
